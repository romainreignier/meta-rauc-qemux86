## conf/layer.conf
```bitbake
# We have a conf and classes directory, add to BBPATH
BBPATH .= ":${LAYERDIR}"

# We have recipes-* directories, add to BBFILES
BBFILES += "${LAYERDIR}/recipes-*/*/*.bb \
            ${LAYERDIR}/recipes-*/*/*.bbappend"

BBFILE_COLLECTIONS += "meta-rauc-qemu"
BBFILE_PATTERN_meta-rauc-qemu = "^${LAYERDIR}/"
BBFILE_PRIORITY_meta-rauc-qemu = "6"

LAYERDEPENDS_meta-rauc-qemu = "core"
LAYERSERIES_COMPAT_meta-rauc-qemu = "warrior"
```

## wic/qemux86-grub-efi.wks
```
bootloader --ptable gpt
part /boot --source rootfs --rootfs-dir=${IMAGE_ROOTFS}/boot --fstype=vfat --ondisk sda --label boot --active --align 1024
part /rescue --source rootfs --ondisk sda --fstype=ext4 --label rescue --align 1024 --exclude-path boot
part / --source rootfs --ondisk sda --fstype=ext4 --label rootA --align 1024 --exclude-path boot
part /systemb --source rootfs --ondisk sda --fstype=ext4 --label rootB --align 1024 --exclude-path boot
```

## wic/qemux86-systemd-boot-efi.wks
```
bootloader --ptable gpt --timeout=5 --append="console=ttyS0,115200"
part /boot --source bootimg-efi --sourceparams="loader=systemd-boot" --fstype=vfat --ondisk sda --label boot0 --active --align 1024 --fixed-size=100
part /boot1  --sourceparams="loader=systemd-boot" --fstype=vfat --ondisk sda --label boot1 --active --align 1024 --fixed-size=100
part / --source rootfs --ondisk sda --fstype=ext4 --label system0 --align 1024
part /system1 --source rootfs --ondisk sda --fstype=ext4 --label system1 --align 1024
```
